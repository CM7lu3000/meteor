## drivers/broadcast/Kconfig
```kconfig
#
# Broadcast Device Driver Support
#

menu "BROADCAST_DEVICE"

menu "Device Select"
config LGE_BROADCAST
	bool "LGE broacast device support"
	default y
	help
	  Select this if you want to use broadcast service
config LGE_BROADCAST_FC8050
	bool "fc8050 device support"
#//--[[ LGE_UBIQUIX_MODIFIED_START : ymjun@mnbt.co.kr [2011.06.21] - TDMB (Add PRODUCT feature) 
	depends on LGE_BROADCAST && (PRODUCT_LGE_BLACK || PRODUCT_LGE_JUSTIN)
#//--]] LGE_UBIQUIX_MODIFIED_END : ymjun@mnbt.co.kr [2011.06.21] - TDMB (Add PRODUCT feature)
	default y
config LGE_BROADCAST_LG2102
	bool "lg2102 device support"
#//--[[ LGE_UBIQUIX_MODIFIED_START : ymjun@mnbt.co.kr [2011.06.21] - TDMB (Add PRODUCT feature) 
	depends on LGE_BROADCAST && PRODUCT_LGE_HUB
#//--]] LGE_UBIQUIX_MODIFIED_END : ymjun@mnbt.co.kr [2011.06.21] - TDMB (Add PRODUCT feature)
	default y
endmenu

menu "Device Interface Select"
config LGE_BROADCAST_TSIF
	bool "TSIF support"
	depends on LGE_BROADCAST
	default n
config LGE_BROADCAST_SPI
	bool "SPI support"
	depends on LGE_BROADCAST
	default y
config LGE_BROADCAST_EBI
	bool "EBI support"
	depends on LGE_BROADCAST
	default n
comment "Device is not selected"
	depends on !LGE_BROADCAST
endmenu
endmenu
```

## drivers/misc/hub_sensors/Kconfig
```kconfig
#config MPU_SENSORS_MPU3050
#    tristate "MPU3050"
#    default y
#    help
#      If you say yes here you get support for the MPU3050 Gyroscope driver
#      This driver can also be built as a module.  If so, the module
#      will be called mpu3050.

config HUB_SENSORS
	bool "HUB Sensors"
	help
		This enables support for the Optimus hub sensors.

config HUB_PROXI_SENSOR
	bool "GP2AP Proximity"
	depends on HUB_SENSORS
	help
		This enables support for the Optimus hub GP2AP proximity.

config HUB_KXTF9
    bool "Kionix KXTF9"
	depends on HUB_SENSORS
    help
      This enables support for the Optimus hub Kionix KXFT9 accelerometer.

config HUB_COMPASS
    bool "AKM akm8973"
	depends on HUB_SENSORS
	help
      This enables support for the Optimus hub AKM ak8973 compass.

#config HUB_SENSORS_AKM8973
#	bool "AKM AKM8973"
#	default y
#	help
#		This enables support for the Optimus hub AKM akm8973 Compass.

#config MPU_SENSORS_TIMERIRQ
#    bool "Timer IRQ"
#    default y
#    help
#      If you say yes here you get access to the timerirq device handle which
#      can be used to select on.  This can be used instead of IRQ's, sleeping,
#      or timer threads.  Reading from this device returns the same type of
#     information as reading from the MPU and slave IRQ's.

#config HUB_SENSORS_DEBUG
#    bool "MPU debug"
#    default y
#    help
#      If you say yes here you get extra debug messages from the MPU3050
#      and other slave sensors.
```
